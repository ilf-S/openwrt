// SPDX-License-Identifier: (GPL-2.0 OR MIT)

/* BPI‑RV2 – AT86RF212B on SPI1 / CE0 (header pin 24) */

&xgmac5 {                       /* free the pin block */
        status = "disabled";
};

/* enable header‑SPI clocks */
&topcrm {
        siflower,critical-gates = <0x02 0x03>;   /* spi1_apb, spi1_ssp */
};

&spi1 {                         /* controller @0xc201000 */
        status          = "okay";
        pinctrl-names   = "default";
        pinctrl-0       = <&spi1_pins>;          /* FUNC_MODE1 mapping */
	spi-num-chipselects = <1>;
        cs-gpios        = <&gpio 24 GPIO_ACTIVE_LOW>;    /* CE0 */
        num-cs          = <1>;

        at86rf212b@0 {
                compatible          = "atmel,at86rf212b";
                reg                 = <0>;              /* CE0 */
                spi-max-frequency   = <1000000>;        /* 1 MHz for jump wires */

                /* IRQ on GPIO20 (header pin 7) */
                interrupts-extended = <&gpio 20 IRQ_TYPE_EDGE_RISING>;

                ieee802154;
        };
};
